## meta-imx-ml/conf/layer.conf
```bitbake
# We have a conf and classes directory, add to BBPATH
BBPATH .= ":${LAYERDIR}"

# We have a packages directory, add to BBFILES
BBFILES += "${@bb.utils.contains_any('MACHINE', '${BSP_NXP_DERIVED}', '${LAYERDIR}/recipes-*/*/*.bb', '', d)}"
BBFILES += "${@bb.utils.contains_any('MACHINE', '${BSP_NXP_DERIVED}', '${LAYERDIR}/recipes-*/*/*.bbappend', '', d)}"

BBFILE_COLLECTIONS += "imx-machine-learning"
BBFILE_PATTERN_imx-machine-learning := "^${LAYERDIR}/"
BBFILE_PRIORITY_imx-machine-learning = "8"

RECIPE_LIST_REASON:imx-machine-learning = "You are about to enable third-party components, there is additional third-part licensing involved, and you might need to consult with your legal department."

LAYERSERIES_COMPAT_imx-machine-learning = "mickledore nanbield scarthgap"
```

## meta-imx-sdk/conf/layer.conf
```bitbake
# We have a conf and classes directory, add to BBPATH
BBPATH .= ":${LAYERDIR}"

# We have a packages directory, add to BBFILES
BBFILES += "${@bb.utils.contains_any('MACHINE', '${BSP_NXP_DERIVED}', '${LAYERDIR}/recipes-*/*/*.bb', '', d)}"
BBFILES += "${@bb.utils.contains_any('MACHINE', '${BSP_NXP_DERIVED}', '${LAYERDIR}/recipes-*/*/*.bbappend', '', d)}"

BBFILE_COLLECTIONS += "fsl-sdk-release"
BBFILE_PATTERN_fsl-sdk-release := "^${LAYERDIR}/"
BBFILE_PRIORITY_fsl-sdk-release = "8"
LAYERSERIES_COMPAT_fsl-sdk-release = "mickledore nanbield scarthgap"

BBMASK += "${LAYERDIR}/recipes-security/"
BBMASK += "${LAYERDIR}/dynamic-layers/"

RECIPE_LIST_REASON:fsl-sdk-release = "You are about to enable third-party components, there is additional third-part licensing involved, and you might need to consult with your legal department."

BBFILES_DYNAMIC += " \
    chromium-browser-layer:${LAYERDIR}/dynamic-layers/chromium-browser-layer/*/*/*.bb \
    chromium-browser-layer:${LAYERDIR}/dynamic-layers/chromium-browser-layer/*/*/*.bbappend \
    \
    openembedded-layer:${LAYERDIR}/dynamic-layers/openembedded-layer/*/*/*.bb \
    openembedded-layer:${LAYERDIR}/dynamic-layers/openembedded-layer/*/*/*.bbappend \
    \
    multimedia-layer:${LAYERDIR}/dynamic-layers/multimedia-layer/*/*/*.bb \
    multimedia-layer:${LAYERDIR}/dynamic-layers/multimedia-layer/*/*/*.bbappend \
    \
    qt6-layer:${LAYERDIR}/dynamic-layers/qt6-layer/*/*/*.bb \
    qt6-layer:${LAYERDIR}/dynamic-layers/qt6-layer/*/*/*.bbappend \
    \
    virtualization-layer:${LAYERDIR}/dynamic-layers/virtualization-layer/*/*/*.bb \
    virtualization-layer:${LAYERDIR}/dynamic-layers/virtualization-layer/*/*/*.bbappend \
    virtualization-layer:${LAYERDIR}/dynamic-layers/virtualization-layer/*/*/*.inc \
    \
    nxp-matter-baseline:${LAYERDIR}/dynamic-layers/matter-layer/*/*/*.bb \
    nxp-matter-baseline:${LAYERDIR}/dynamic-layers/matter-layer/*/*/*.bbappend \
    nxp-openthread:${LAYERDIR}/dynamic-layers/matter-layer/*/*/*.bbappend \
"

BBMASK += " \
    meta-freescale-distro/recipes-fsl/packagegroups/packagegroup-fsl-tools-gpu-external.bb \
"
```
